## CMakeLists.txt
```
cmake_minimum_required(VERSION 3.20.0)

find_package(Zephyr REQUIRED HINTS $ENV{ZEPHYR_BASE})
project(alc_mailbox_monitor)

target_sources(app PRIVATE
  src/main.cpp
  src/app.cpp
  src/adxl367.cpp
  src/led.cpp
  src/modem.cpp
  src/mqtt.cpp
  src/npm1300.cpp
  src/fuel_gauge.cpp
  src/retained.cpp
)
```

## prj.conf
```kconfig
# ============================================
# ALC Mailbox Monitor - Project Configuration
# ============================================
# Target: Thingy91x (nRF9151 + ADXL367)
# Network: LTE-M (Cat-M1)
# NCS Version: 3.1.0
# ============================================

# C++ Support
CONFIG_CPP=y
CONFIG_STD_CPP20=y
CONFIG_REQUIRES_FULL_LIBCPP=n
CONFIG_MINIMAL_LIBCPP=n

# Application Stack and Heap
CONFIG_MAIN_STACK_SIZE=8192
CONFIG_SYSTEM_WORKQUEUE_STACK_SIZE=2048
CONFIG_HEAP_MEM_POOL_SIZE=16384
CONFIG_EVENTS=y

# ===== Modem Library =====
CONFIG_NRF_MODEM_LIB=y
CONFIG_NRF_MODEM_LIB_ON_FAULT_RESET_MODEM=y
CONFIG_NRF_MODEM_LIB_TRACE=n
CONFIG_NRF_MODEM_LIB_HEAP_SIZE=2048
CONFIG_MODEM_KEY_MGMT=y
CONFIG_MODEM_INFO=y
CONFIG_MODEM_INFO_ADD_NETWORK=y

# ===== LTE Link Control - LTE-M =====
CONFIG_LTE_LINK_CONTROL=y
CONFIG_LTE_NETWORK_MODE_LTE_M=y

# ===== Networking =====
CONFIG_NETWORKING=y
CONFIG_NET_NATIVE=y
CONFIG_NET_SOCKETS=y
CONFIG_NET_SOCKETS_OFFLOAD=y
CONFIG_NET_TCP=y
CONFIG_NET_IPV4=y
CONFIG_NET_IPV6=n
CONFIG_POSIX_API=y

# ===== MQTT =====
CONFIG_MQTT_LIB=y
CONFIG_MQTT_LIB_TLS=y
CONFIG_MQTT_CLEAN_SESSION=y
# Note: Security tag is defined in code, not Kconfig.

# Fuel Gauge
CONFIG_SENSOR=y
CONFIG_CHARGER=y
CONFIG_NRF_FUEL_GAUGE=y
CONFIG_NRF_FUEL_GAUGE_VARIANT_SECONDARY_CELL=y
CONFIG_REQUIRES_FLOAT_PRINTF=y

# ===== I2C for ADXL367 =====
CONFIG_I2C=y

# ===== GPIO and PWM =====
CONFIG_GPIO=y
CONFIG_PWM=y

# ===== Logging =====
CONFIG_LOG=y
CONFIG_LOG_DEFAULT_LEVEL=3
CONFIG_USE_SEGGER_RTT=n
CONFIG_LOG_BACKEND_RTT=n
CONFIG_LOG_BACKEND_UART=y
CONFIG_LOG_BUFFER_SIZE=2048
CONFIG_LOG_MODE_IMMEDIATE=y
CONFIG_PRINTK=y

# ===== Random Number Generator =====
CONFIG_ENTROPY_GENERATOR=y

# ===== Power Management =====
CONFIG_PM=n
CONFIG_REBOOT=y

# ===== Thread Configuration =====
CONFIG_THREAD_NAME=y

# ===== TF-M / Crypto =====
CONFIG_BUILD_WITH_TFM=y
CONFIG_TFM_PARTITION_PLATFORM=y
CONFIG_TFM_CRYPTO_RNG_MODULE_ENABLED=y

# PSA Crypto for TLS.
CONFIG_PSA_WANT_ALG_HMAC=y
CONFIG_PSA_WANT_ALG_SHA_256=y
CONFIG_PSA_WANT_KEY_TYPE_HMAC=y
CONFIG_PSA_WANT_KEY_TYPE_RAW_DATA=y

# ===== Flash / Settings =====
CONFIG_FLASH=y
CONFIG_FLASH_MAP=y
CONFIG_FLASH_PAGE_LAYOUT=y
CONFIG_NVS=y
CONFIG_MPU_ALLOW_FLASH_WRITE=y
CONFIG_SETTINGS=y
CONFIG_FCB=y
CONFIG_SETTINGS_FCB=y
CONFIG_PM_PARTITION_SIZE_SETTINGS_STORAGE=0x4000

# ===== Debug =====
CONFIG_DEBUG=n
CONFIG_DEBUG_OPTIMIZATIONS=n
```

## boards/thingy91x_nrf9151_ns.overlay
```dts
/ {
  aliases {
    pmic-main = &pmic_main;
    charger = &npm1300_charger;
    led0-red = &pwm_led0;
    led0-green = &pwm_led1;
    led0-blue = &pwm_led2;
  };
};

&pmic_main {
  status = "okay";
};

&npm1300_charger {
  status = "okay";
};
```

## src/main.cpp
```c
/*
 * @file main.cpp
 * @brief ALC Mailbox Monitor - Main Entry Point.
 *
 * Ultra-low power mailbox monitoring using:
 * - nRF9151 with LTE-M for cellular connectivity
 * - ADXL367 in wake-up mode for motion detection
 * - System OFF for minimum power consumption
 *
 * Device ID prefix: cccc (ALC_Mailbox_Monitor series)
 *
 * IMPORTANT: Wake source detection happens BEFORE App construction
 * to ensure GPIO latches are read before any driver init.
 */

#include <zephyr/kernel.h>
#include <zephyr/logging/log.h>
#include <hal/nrf_gpio.h>
#include <hal/nrf_power.h>

#include "app.hpp"

LOG_MODULE_REGISTER(main, LOG_LEVEL_INF);

// GPIO pins for wake detection (must match app.hpp).
static constexpr uint32_t PIN_ACCEL_INT { 11 };   // ADXL367 INT1.
static constexpr uint32_t PIN_PMIC_INT { 2 };     // nPM1300 SHPHLD GPIO (door-open timer).

/**
 * @brief Identify wake source BEFORE any driver/class initialisation.
 *
 * This MUST be called before the App object is constructed, as
 * constructor initialisation of hardware objects can affect GPIO states.
 */
// Captured before any driver init — true if AWAKE pin was still HIGH at boot.
static bool s_awakeAtBoot { false };

static alc::WakeSource identifyWakeSourceEarly()
{
  uint32_t resetReason { nrf_power_resetreas_get(NRF_POWER_NS) };

  // Clear reset reason after reading.
  nrf_power_resetreas_clear(NRF_POWER_NS, resetReason);

  LOG_INF("Reset reason: 0x%08X", resetReason);

  // If not from System OFF, it's a fresh boot.
  if (!(resetReason & POWER_RESETREAS_OFF_Msk)) {
    LOG_INF("Fresh boot (not System OFF wake).");
    return alc::WakeSource::PowerOn;
  }

  LOG_INF("System OFF wake detected. Checking GPIO latches...");

  // Check accelerometer latch (P0.11) - MUST check before any I2C activity.
  if (nrf_gpio_pin_latch_get(PIN_ACCEL_INT)) {
    LOG_INF("  Accelerometer latch SET (P0.%d)", PIN_ACCEL_INT);
    // Read raw pin level BEFORE any driver init resets the ADXL367.
    // If pin is still HIGH, AWAKE is active (motion ongoing).
    // If LOW, motion was brief but real (latch proves rising edge occurred).
    uint32_t pinLevel { nrf_gpio_pin_read(PIN_ACCEL_INT) };
    s_awakeAtBoot = (pinLevel != 0);
    LOG_INF("  INT1 pin level: %u (AWAKE %s)", pinLevel,
            pinLevel ? "ACTIVE" : "cleared");
    nrf_gpio_pin_latch_clear(PIN_ACCEL_INT);
    return alc::WakeSource::Accelerometer;
  }

  // Check PMIC/Timer latch (P0.02) - door-open timer wake.
  if (nrf_gpio_pin_latch_get(PIN_PMIC_INT)) {
    LOG_INF("  PMIC/Timer latch SET (P0.%d)", PIN_PMIC_INT);
    nrf_gpio_pin_latch_clear(PIN_PMIC_INT);
    return alc::WakeSource::Timer;
  }

  // System OFF wake but no latch identified.
  LOG_WRN("System OFF wake but no GPIO latch set!");
  return alc::WakeSource::Unknown;
}

int main()
{
  LOG_INF("===========================================");
  LOG_INF("  ALC MAILBOX MONITOR");
  LOG_INF("  Firmware Version: 0.4.0");
  LOG_INF("===========================================");

  // =========================================================================
  // CRITICAL: Detect wake source BEFORE App construction.
  // The App constructor initialises hardware objects which can affect GPIOs.
  // =========================================================================
  alc::WakeSource wake { identifyWakeSourceEarly() };
  LOG_INF("Wake source: %s", alc::wakeSourceToString(wake));

  // Create application instance and start with detected wake source.
  // Start() does not return - it enters System OFF at the end.
  alc::App app;
  app.Start(wake, s_awakeAtBoot);

  // Should never reach here.
  return 0;
}
```

## src/adxl367.hpp
```c
#pragma once

/**
 * @file adxl367.hpp
 * @brief Simplified ADXL367 driver for ALC Mailbox Monitor.
 * 
 * Stripped-down version focused on:
 * - Wake-up mode operation (180nA)
 * - Activity detection for mailbox lid movement
 * - INT1 AWAKE signal for System OFF wake
 * - MQTT-configurable thresholds
 * 
 * Removed features not needed for mailbox monitoring:
 * - Tap detection
 * - Temperature sensing
 * - Data streaming
 * - GPIO interrupt callbacks (using System OFF wake instead)
 */

#include <zephyr/device.h>
#include <zephyr/drivers/i2c.h>

namespace alc 
{
  class Adxl367 
  {
    public:
      // ========== Enumerations ==========

      enum class I2cAddress : uint8_t {
        AddrHigh = 0x53,  ///< ASEL pin high (default on Thingy91x).
        AddrLow  = 0x1D   ///< ASEL pin low.
      };

      enum class Range : uint8_t {
        Range2g = 0,    ///< ±2g range (0.25 mg/LSB).
        Range4g = 1,    ///< ±4g range (0.5 mg/LSB).
        Range8g = 2     ///< ±8g range (1.0 mg/LSB).
      };

      enum class OperatingMode : uint8_t {
        Standby     = 0,  ///< Standby mode (40 nA).
        Measurement = 2   ///< Measurement mode.
      };

      enum class ActivityMode : uint8_t {
        Disabled   = 0,   ///< Detection disabled.
        Absolute   = 1,   ///< Absolute threshold detection.
        Referenced = 3    ///< Referenced (relative) detection.
      };

      enum class LinkLoopMode : uint8_t {
        Default = 0,    ///< Both enabled simultaneously.
        Linked  = 1,    ///< Sequential, interrupts require servicing.
        Loop    = 3     ///< Sequential, auto-acknowledged.
      };

      enum class WakeupRate : uint8_t {
        Rate12Sps  = 0,   ///< 12 samples/sec (fastest detection).
        Rate6Sps   = 1,   ///< 6 samples/sec (default).
        Rate3Sps   = 2,   ///< 3 samples/sec.
        Rate1_5Sps = 3    ///< 1.5 samples/sec (lowest power).
      };

      enum class ODR : uint8_t {
        Hz12_5 = 0,   ///< 12.5 Hz.
        Hz25   = 1,   ///< 25 Hz.
        Hz50   = 2,   ///< 50 Hz.
        Hz100  = 3,   ///< 100 Hz.
        Hz200  = 4,   ///< 200 Hz.
        Hz400  = 5    ///< 400 Hz.
      };

      enum class FifoMode : uint8_t {
        Disabled    = 0,  ///< FIFO disabled.
        OldestSaved = 1,  ///< Fills then stops.
        Stream      = 2,  ///< Always contains most recent data.
        Triggered   = 3   ///< Captures around activity event.
      };

      enum class IntPin : uint8_t {
        Int1 = 1,
        Int2 = 2
      };

      // ========== Structures ==========

      /**
       * @brief Device status register contents.
       */
      struct Status {
        bool dataReady;          ///< New data available.
        bool fifoReady;          ///< FIFO has at least one sample.
        bool fifoWatermark;      ///< FIFO contains >= watermark samples.
        bool fifoOverrun;        ///< FIFO has overrun.
        bool activityDetected;   ///< Activity detected.
        bool inactivityDetected; ///< Inactivity detected.
        bool awake;              ///< Device is in awake state.
        bool errUserRegs;        ///< SEU error in user registers.
      };

      /**
       * @brief Single XYZ sample from FIFO (converted to mg).
       */
      struct FifoSample {
        int16_t x;   ///< X-axis in mg.
        int16_t y;   ///< Y-axis in mg.
        int16_t z;   ///< Z-axis in mg.
      };

      /**
       * @brief Activity/inactivity configuration.
       * 
       * All threshold values are in mg (milli-g).
       * Time values are in samples at the current wake-up rate.
       */
      struct ActivityConfig {
        ActivityMode activityMode;    ///< Activity detection mode.
        ActivityMode inactivityMode;  ///< Inactivity detection mode.
        LinkLoopMode linkLoop;        ///< Link/loop mode.
        uint16_t activityThreshold;   ///< Activity threshold in mg.
        uint8_t activityTime;         ///< Activity time in samples.
        uint16_t inactivityThreshold; ///< Inactivity threshold in mg.
        uint16_t inactivityTime;      ///< Inactivity time in samples.
      };

      /**
       * @brief Default configuration suitable for mailbox monitoring.
       * 
       * Uses referenced activity (detects change from rest) and absolute
       * inactivity (returns to sleep when acceleration < 1g).
       */
      static constexpr ActivityConfig DEFAULT_MAILBOX_CONFIG {
        .activityMode = ActivityMode::Referenced,
        .inactivityMode = ActivityMode::Referenced,
        .linkLoop = LinkLoopMode::Loop,
        .activityThreshold = 250,     // 250mg - detect lid movement.
        .activityTime = 1,            // 1 sample.
        .inactivityThreshold = 250,   // 250mg - referenced mode, change from ref.
        .inactivityTime = 10          // ~1.6s at 6 SPS.
      };

      // ========== Constructor ==========

      /**
       * @brief Constructor.
       * @param i2cDev Pointer to I2C device.
       * @param addr I2C address selection (based on ASEL pin).
       */
      Adxl367(const struct device* i2cDev, I2cAddress addr = I2cAddress::AddrLow);

      // ========== Initialisation ==========

      /**
       * @brief Initialise the accelerometer.
       * 
       * Performs soft reset and verifies device ID.
       * 
       * @return 0 on success, negative error code on failure.
       */
      int Init();

      /**
       * @brief Perform software reset.
       * @return 0 on success, negative error code on failure.
       */
      int SoftReset();

      // ========== Operating Mode ==========

      /**
       * @brief Set operating mode.
       * @param mode Operating mode (Standby or Measurement).
       * @return 0 on success, negative error code on failure.
       */
      int SetOperatingMode(OperatingMode mode);

      /**
       * @brief Enable wake-up mode for ultra-low power operation.
       * 
       * In wake-up mode, the device samples at a reduced rate (6 SPS default)
       * and only outputs the AWAKE signal when activity is detected.
       * Power consumption: ~180 nA.
       * 
       * @param rate Wake-up sampling rate.
       * @return 0 on success, negative error code on failure.
       */
      int EnableWakeupMode(WakeupRate rate = WakeupRate::Rate6Sps);

      /**
       * @brief Set wake-up sampling rate without enabling wake-up mode.
       *
       * Sets TIMER_CTL[7:6] wake-up rate. Used with autosleep mode where
       * the device autonomously enters wake-up mode at this rate.
       *
       * @param rate Wake-up sampling rate.
       * @return 0 on success, negative error code on failure.
       */
      int SetWakeupRate(WakeupRate rate);

      /**
       * @brief Disable wake-up mode (switch to full ODR measurement).
       * @return 0 on success, negative error code on failure.
       */
      int DisableWakeupMode();

      /**
       * @brief Enter measurement mode with autosleep enabled.
       *
       * Writes POWER_CTL = 0x06 (MEASURE=10, AUTOSLEEP=1).
       * In loop mode, autosleep causes the device to enter wake-up mode
       * autonomously when inactivity is detected, and return to measurement
       * mode when activity is detected.
       *
       * @return 0 on success, negative error code on failure.
       */
      int EnableMeasurementAutosleep();

      // ========== Configuration ==========

      /**
       * @brief Set measurement range.
       * @param range Measurement range (±2g, ±4g, or ±8g).
       * @return 0 on success, negative error code on failure.
       */
      int SetRange(Range range);

      /**
       * @brief Set output data rate.
       * @param odr Output data rate.
       * @return 0 on success, negative error code on failure.
       */
      int SetOdr(ODR odr);

      /**
       * @brief Configure activity/inactivity detection.
       * 
       * This is the main configuration for mailbox motion detection.
       * The thresholds can be adjusted via MQTT for tuning.
       * 
       * @param config Activity configuration.
       * @return 0 on success, negative error code on failure.
       */
      int ConfigureActivity(const ActivityConfig& config);

      /**
       * @brief Configure interrupt pin mapping.
       * 
       * For mailbox monitor, we map AWAKE to INT1 (active high).
       * This provides a level signal suitable for System OFF wake.
       * 
       * @param pin Interrupt pin (1 or 2).
       * @param awake Map AWAKE signal to pin.
       * @param activeLow True for active low, false for active high.
       * @return 0 on success, negative error code on failure.
       */
      int ConfigureInterrupt(IntPin pin, bool awake, bool activeLow = false);

      // ========== FIFO ==========

      /**
       * @brief Configure FIFO mode and channel selection.
       * @param mode FIFO operating mode.
       * @param storeXyz Store X, Y, Z channels (the only option we use).
       * @return 0 on success, negative error code on failure.
       */
      int ConfigureFifo(FifoMode mode);

      /**
       * @brief Read number of samples currently in FIFO.
       * @param entries Reference to store the count.
       * @return 0 on success, negative error code on failure.
       */
      int ReadFifoEntries(uint16_t& entries);

      /**
       * @brief Read all available FIFO data as XYZ sample sets.
       *
       * Reads FIFO_ENTRIES, then bulk-reads from I2C_FIFO_DATA (0x18).
       * Each sample is 2 bytes: D[15:14]=channel ID, D[13:0]=signed 14-bit data.
       * Samples arrive in X, Y, Z order (3 samples per set).
       *
       * @param samples Output buffer for decoded XYZ samples.
       * @param maxSets Maximum number of XYZ sets the buffer can hold.
       * @param setsRead Number of complete XYZ sets actually read.
       * @return 0 on success, negative error code on failure.
       */
      int ReadFifo(FifoSample* samples, uint16_t maxSets, uint16_t& setsRead);

      // ========== Status ==========

      /**
       * @brief Read device status.
       * 
       * Reading status clears the interrupt flags.
       * 
       * @param status Reference to Status structure.
       * @return 0 on success, negative error code on failure.
       */
      int ReadStatus(Status& status);

      /**
       * @brief Check if device is awake (motion detected).
       * @return True if awake (motion detected).
       */
      bool IsAwake();

      // ========== Data Register Reads ==========

      /**
       * @brief Read current XYZ acceleration from data registers.
       *
       * Reads XDATA_H/L, YDATA_H/L, ZDATA_H/L and converts to mg.
       * Works in both measurement and wake-up modes.
       *
       * @param x X-axis acceleration in mg.
       * @param y Y-axis acceleration in mg.
       * @param z Z-axis acceleration in mg.
       * @return 0 on success, negative error code on failure.
       */
      int ReadAxes(int16_t& x, int16_t& y, int16_t& z);

      /**
       * @brief Read raw temperature value from data registers.
       *
       * Returns the raw 14-bit ADC value. To convert to degrees C:
       *   tempC = (rawValue - tempBias) * tempSlope
       * where tempBias and tempSlope are device-specific (see datasheet).
       *
       * @param tempRaw Raw 14-bit temperature ADC value.
       * @return 0 on success, negative error code on failure.
       */
      int ReadTemperature(int16_t& tempRaw);

      // ========== Threshold Updates (for MQTT tuning) ==========

      /**
       * @brief Update activity threshold.
       * 
       * Can be called while in measurement mode to adjust sensitivity.
       * 
       * @param thresholdMg Threshold in milli-g.
       * @return 0 on success, negative error code on failure.
       */
      int SetActivityThreshold(uint16_t thresholdMg);

      /**
       * @brief Update inactivity threshold.
       * @param thresholdMg Threshold in milli-g.
       * @return 0 on success, negative error code on failure.
       */
      int SetInactivityThreshold(uint16_t thresholdMg);

      /**
       * @brief Update inactivity time.
       * @param samples Number of samples (at wake-up rate).
       * @return 0 on success, negative error code on failure.
       */
      int SetInactivityTime(uint16_t samples);

      // ========== Debug ==========

      /**
       * @brief Print current configuration for debugging.
       */
      void PrintConfiguration();

      /**
       * @brief Read a register for debug purposes.
       * @param reg Register address.
       * @param value Reference to store the value.
       * @return 0 on success, negative error code on failure.
       */
      int ReadRegisterDebug(uint8_t reg, uint8_t& value);

    private:
      const struct device* m_i2c;
      uint8_t m_i2cAddr;
      Range m_currentRange;

      // I2C communication helpers.
      int writeRegister(uint8_t reg, uint8_t value);
      int readRegister(uint8_t reg, uint8_t& value);
      int updateRegister(uint8_t reg, uint8_t value, uint8_t mask);
      int readBurst(uint8_t reg, uint8_t* buffer, uint16_t length);

      // Conversion helpers.
      uint16_t mgToThreshold(uint16_t mg);
      float getScaleFactor();

      // Device verification.
      int verifyDeviceId();

      // Constants.
      static constexpr uint8_t M_STARTUP_DELAY_MS { 100 };
      static constexpr uint8_t M_RESET_DELAY_MS { 8 };
  };

} // namespace alc
```

## src/app.hpp
```c
#pragma once

/**
 * @file app.hpp
 * @brief ALC Mailbox Monitor Application.
 *
 * Single-wake state machine for detecting mailbox events:
 *
 * Logic:
 * 1. Device sleeps in System OFF (nA power consumption).
 * 2. Motion detected → ADXL367 AWAKE signal wakes device.
 * 3. Classify event by settled position (home vs not home).
 * 4. Home → send "mailbox_visited". Not home → start escalating door-open timer.
 * 5. Return to System OFF.
 *
 * ADXL367 uses referenced activity/inactivity in loop mode with autosleep.
 * AWAKE stays HIGH while device is displaced from its rest position and
 * only clears when returned to the home orientation.
 *
 * Wake sources:
 * - ADXL367 INT1 (P0.11): Motion detection
 * - nPM1300 Timer GPIO (P0.02): Escalating door-open timer
 * - Hall Sensor (TBD): Owner interaction (future)
 */

#include <zephyr/kernel.h>
#include <zephyr/device.h>

#include "adxl367.hpp"
#include "modem.hpp"
#include "mqtt.hpp"
#include "npm1300.hpp"
#include "retained.hpp"

namespace alc
{
  // ========== Configuration Constants ==========

  // Timing defaults (configurable via MQTT).
  constexpr uint32_t M_MAIL_WINDOW_SECS { 240 };        // 4 minutes - defines open/close cycle.
  constexpr uint32_t M_HEARTBEAT_HOUR { 3 };            // 3am for nightly heartbeat.

  // Door-open escalating timer durations (seconds).
  // Stage 1: 4 minutes, Stage 2: 1 hour, Stage 3: 2 hours.
  // Testing values: 20s / 30s / 40s — swap comments for production.
  // constexpr uint32_t M_DOOR_OPEN_DURATIONS[] { 20, 30, 40 };     // Testing.
  constexpr uint32_t M_DOOR_OPEN_DURATIONS[] { 240, 3600, 7200 }; // Production.
  constexpr uint8_t M_DOOR_OPEN_MAX_STAGE { 3 };

  // ADXL367 defaults (configurable via MQTT).
  constexpr uint16_t M_ACTIVITY_THRESHOLD_MG { 200 };   // Activity threshold in mg (detects ~15° door opening).
  constexpr uint8_t M_ACTIVITY_TIME { 1 };              // Activity time in samples.
  constexpr uint16_t M_INACTIVITY_THRESHOLD_MG { 250 }; // Inactivity threshold in mg (referenced mode).
  constexpr uint8_t M_INACTIVITY_TIME { 10 };           // Inactivity time in samples.

  // Provisioning mode poll interval limits (seconds).
  constexpr uint16_t M_DEFAULT_POLL_INTERVAL { 60 };
  constexpr uint16_t M_MIN_POLL_INTERVAL { 10 };
  constexpr uint16_t M_MAX_POLL_INTERVAL { 300 };

  // MQTT settings.
  constexpr size_t M_MQTT_MESSAGE_LENGTH { 256 };
  constexpr size_t M_MQTT_TOPIC_LENGTH { 128 };
  constexpr size_t M_MQTT_CONNECTION_RETRIES { 100 };

  // Modem timeout (LTE-M connection can be slow).
  constexpr int M_MODEM_TIMEOUT_SEC { 90 };

  // LED flash period.
  constexpr uint32_t M_LED_FLASH_PERIOD_MS { 250 };

  // ========== Wake Source Identification ==========

  enum class WakeSource {
    Unknown,
    PowerOn,          // Fresh boot / reset.
    Accelerometer,    // ADXL367 motion detected (P0.11).
    Timer,            // nPM1300 timer (P0.02) - door-open escalation.
    HallSensor        // Owner interaction - future.
  };

  // Free function for wake source string conversion.
  const char* wakeSourceToString(WakeSource source);

  // ========== MQTT Command Types ==========

  enum class MqttCommand {
    SET_MAIL_WINDOW,
    SET_ACTIVITY_THRESHOLD,
    SET_ACTIVITY_TIME,
    SET_INACTIVITY_THRESHOLD,
    SET_INACTIVITY_TIME,
    SET_MAX_BUFFERED_EVENTS,
    RESET_CONFIG,
    REQUEST_STATUS,
    FIRMWARE_UPDATE,
    DEVICE_RESET,
    ENABLE,
    DISABLE,
    SET_POLL_INTERVAL,
    CALIBRATE,
    REPORT_POSITION,
    UNKNOWN
  };

  // ========== Runtime Configuration ==========

  struct MailboxConfig {
    // Timer settings.
    uint32_t mailWindowSecs;

    // ADXL367 activity/inactivity settings.
    uint16_t activityThresholdMg;
    uint8_t activityTime;
    uint16_t inactivityThresholdMg;
    uint8_t inactivityTime;

    void setDefaults() {
      mailWindowSecs = M_MAIL_WINDOW_SECS;
      activityThresholdMg = M_ACTIVITY_THRESHOLD_MG;
      activityTime = M_ACTIVITY_TIME;
      inactivityThresholdMg = M_INACTIVITY_THRESHOLD_MG;
      inactivityTime = M_INACTIVITY_TIME;
    }
  };

  // ========== Application Class ==========

  class App
  {
    public:
      App();

      /**
       * @brief Start the application.
       *
       * Initialises hardware, handles the wake event, then enters System OFF.
       * This function does not return.
       *
       * @param wake The wake source (detected in main before App construction).
       * @param awakeAtBoot True if ADXL367 INT1 pin was HIGH at boot (before init).
       */
      void Start(WakeSource wake, bool awakeAtBoot = false);

      // MQTT callbacks.
      void OnMqttConnected();
      void OnMqttDisconnected();
      void OnMqttMessageReceived(const char* message, size_t length);

    private:
      // ========== Wake Handling ==========

      /**
       * @brief Handle motion wake - single-wake mail detection.
       *
       * Polls AWAKE until device returns to rest, then sends mail event.
       * MCU stays awake during the entire open period.
       */
      void handleMotionWake();

      /**
       * @brief Handle timer wake - escalating door-open notifications.
       */
      void handleTimerWake();

      /**
       * @brief Handle Hall sensor wake - owner interaction (future stub).
       */
      void handleHallSensorWake();

      /**
       * @brief Handle fresh boot / power-on.
       */
      void handleFreshBoot();

      /**
       * @brief Handle provisioning mode when device is disabled.
       *
       * Connects to cloud, sends status, checks for enable command, then
       * sleeps for poll_interval. Does not return until device is enabled.
       */
      void handleProvisioningMode();

      /**
       * @brief Initialise the event buffer subsystem.
       *
       * Loads buffered events from NVS flash.
       */
      void initEventBuffer();

      // ========== Hardware Initialisation ==========

      /**
       * @brief Initialise essential hardware (PMIC, accelerometer).
       *
       * This is the minimal init needed for OPEN events.
       * @return true on success.
       */
      bool initHardware(WakeSource wake);

      /**
       * @brief Initialise network hardware (modem, MQTT).
       *
       * Called lazily on CLOSE events when network access is needed.
       * @return true on success.
       */
      bool initNetworkHardware();

      // ========== MQTT Operations ==========

      /**
       * @brief Connect to network and MQTT broker.
       */
      bool connectToCloud();

      /**
       * @brief Disconnect from MQTT and network.
       */
      void disconnectFromCloud();

      /**
       * @brief Send a mailbox event (visited or open).
       * @param timestamp Event timestamp (seconds since boot, TODO: RTC epoch).
       * @param smsSuppressed Whether to suppress SMS notification.
       * @param type Event type (MailboxVisited or MailboxOpen).
       */
      bool sendMailboxEvent(uint32_t timestamp, bool smsSuppressed, EventType type, uint8_t doorOpenStage = 0);

      /**
       * @brief Send all buffered mail events.
       *
       * Sends oldest events first with sms_suppress=true (to suppress SMS).
       * The most recent event is sent with its actual sms_suppress value.
       *
       * @return true if all events were sent successfully.
       */
      bool sendBufferedEvents();

      /**
       * @brief Send heartbeat / status report.
       */
      bool sendHeartbeat();

      /**
       * @brief Send battery status.
       */
      bool sendBatteryStatus();

      /**
       * @brief Send current configuration status.
       */
      bool sendConfigStatus();

      /**
       * @brief Collect any pending MQTT commands.
       */
      void collectMqttCommands();

      // ========== Command Handling ==========

      MqttCommand parseCommand(const char* message, size_t length);
      void executeCommand(MqttCommand cmd, const char* message, size_t length);
      int extractIntValue(const char* message, const char* key);
      void clearRetainedCommand();

      // ========== Sensor Configuration ==========

      /**
       * @brief Configure ADXL367 for motion wake-up.
       */
      int configureMotionSensor();

      // ========== Timer Configuration ==========

      /**
       * @brief Initialise nPM1300 GP Timer (GP mode, slow prescaler).
       */
      int configureMailWindowTimer();

      // ========== Power Management ==========

      /**
       * @brief Configure GPIO pins for System OFF wake.
       */
      void configureWakeSources();

      /**
       * @brief Shutdown modem for lowest power.
       */
      void shutdownModem();

      /**
       * @brief Enter System OFF mode.
       *
       * Device will wake on configured GPIO events.
       * This function does not return.
       */
      void enterSystemOff();

      /**
       * @brief Execute device reset via NVIC_SystemReset().
       *
       * Waits for nPM1300 timer to expire (or mail_window timeout) before
       * resetting, to avoid interrupting an in-progress open/close cycle.
       * This function does not return.
       */
      void executeDeviceReset();

      // ========== Utility ==========

      void buildTopic(char* buffer, size_t size, const char* suffix);

      // ========== Constants ==========

      // Device ID (cccc prefix = Mailbox Monitor series).
      static constexpr const char* M_DEVICE_ID { "ccccddddeeeeffff0000111122221111" };

      // Topic suffixes.
      static constexpr const char* M_SUFFIX_EVENTS { "events" };
      static constexpr const char* M_SUFFIX_STATUS { "status" };
      static constexpr const char* M_SUFFIX_BATTERY { "battery" };
      static constexpr const char* M_SUFFIX_HEARTBEAT { "heartbeat" };
      static constexpr const char* M_SUFFIX_COMMANDS { "commands" };

      // GPIO pins for wake sources.
      static constexpr uint32_t PIN_ACCEL_INT { 11 };   // ADXL367 INT1.
      static constexpr uint32_t PIN_PMIC_INT { 2 };     // nPM1300 SHPHLD GPIO (door-open timer).

      // ========== Hardware Objects ==========

      Modem m_modem;
      Adxl367 m_motion;
      MqttClient m_mqtt;
      Npm1300 m_pmic;

      // ========== Runtime State ==========

      MailboxConfig m_config;

      // Track if network hardware has been initialised.
      bool m_networkInitialised { false };

      // ADXL367 AWAKE state captured before init (motion still ongoing at boot).
      bool m_awakeAtBoot { false };

      // ========== Singleton ==========

      static App* s_instance;
  };
}
```

## src/certificate.h
```c
#pragma once

/**
 * @file certificate.h
 * @brief TLS Certificate for HiveMQ Cloud.
 * 
 * Contains the ISRG Root X1 certificate used by Let's Encrypt.
 * This is the same certificate used by ALC_Help_At_Hand.
 * 
 * NOTE: Copy the actual CA_CERTIFICATE constant from your 
 * ALC_Help_At_Hand project's certificate.h file.
 */

// HiveMQ Cloud uses Let's Encrypt certificates signed by ISRG Root X1.
// This is the same certificate used across all ALC CareFree devices.

static const char CA_CERTIFICATE[] = 
    "-----BEGIN CERTIFICATE-----\n"
    "MIIFazCCA1OgAwIBAgIRAIIQz7DSQONZRGPgu2OCiwAwDQYJKoZIhvcNAQELBQAw\n"
    "TzELMAkGA1UEBhMCVVMxKTAnBgNVBAoTIEludGVybmV0IFNlY3VyaXR5IFJlc2Vh\n"
    "cmNoIEdyb3VwMRUwEwYDVQQDEwxJU1JHIFJvb3QgWDEwHhcNMTUwNjA0MTEwNDM4\n"
    "WhcNMzUwNjA0MTEwNDM4WjBPMQswCQYDVQQGEwJVUzEpMCcGA1UEChMgSW50ZXJu\n"
    "ZXQgU2VjdXJpdHkgUmVzZWFyY2ggR3JvdXAxFTATBgNVBAMTDElTUkcgUm9vdCBY\n"
    "MTCCAiIwDQYJKoZIhvcNAQEBBQADggIPADCCAgoCggIBAK3oJHP0FDfzm54rVygc\n"
    "h77ct984kIxuPOZXoHj3dcKi/vVqbvYATyjb3miGbESTtrFj/RQSa78f0uoxmyF+\n"
    "0TM8ukj13Xnfs7j/EvEhmkvBioZxaUpmZmyPfjxwv60pIgbz5MDmgK7iS4+3mX6U\n"
    "A5/TR5d8mUgjU+g4rk8Kb4Mu0UlXjIB0ttov0DiNewNwIRt18jA8+o+u3dpjq+sW\n"
    "T8KOEUt+zwvo/7V3LvSye0rgTBIlDHCNAymg4VMk7BPZ7hm/ELNKjD+Jo2FR3qyH\n"
    "B5T0Y3HsLuJvW5iB4YlcNHlsdu87kGJ55tukmi8mxdAQ4Q7e2RCOFvu396j3x+UC\n"
    "B5iPNgiV5+I3lg02dZ77DnKxHZu8A/lJBdiB3QW0KtZB6awBdpUKD9jf1b0SHzUv\n"
    "KBds0pjBqAlkd25HN7rOrFleaJ1/ctaJxQZBKT5ZPt0m9STJEadao0xAH0ahmbWn\n"
    "OlFuhjuefXKnEgV4We0+UXgVCwOPjdAvBbI+e0ocS3MFEvzG6uBQE3xDk3SzynTn\n"
    "jh8BCNAw1FtxNrQHusEwMFxIt4I7mKZ9YIqioymCzLq9gwQbooMDQaHWBfEbwrbw\n"
    "qHyGO0aoSCqI3Haadr8faqU9GY/rOPNk3sgrDQoo//fb4hVC1CLQJ13hef4Y53CI\n"
    "rU7m2Ys6xt0nUW7/vGT1M0NPAgMBAAGjQjBAMA4GA1UdDwEB/wQEAwIBBjAPBgNV\n"
    "HRMBAf8EBTADAQH/MB0GA1UdDgQWBBR5tFnme7bl5AFzgAiIyBpY9umbbjANBgkq\n"
    "hkiG9w0BAQsFAAOCAgEAVR9YqbyyqFDQDLHYGmkgJykIrGF1XIpu+ILlaS/V9lZL\n"
    "ubhzEFnTIZd+50xx+7LSYK05qAvqFyFWhfFQDlnrzuBZ6brJFe+GnY+EgPbk6ZGQ\n"
    "3BebYhtF8GaV0nxvwuo77x/Py9auJ/GpsMiu/X1+mvoiBOv/2X/qkSsisRcOj/KK\n"
    "NFtY2PwByVS5uCbMiogziUwthDyC3+6WVwW6LLv3xLfHTjuCvjHIInNzktHCgKQ5\n"
    "ORAzI4JMPJ+GslWYHb4phowim57iaztXOoJwTdwJx4nLCgdNbOhdjsnvzqvHu7Ur\n"
    "TkXWStAmzOVyyghqpZXjFaH3pO3JLF+l+/+sKAIuvtd7u+Nxe5AW0wdeRlN8NwdC\n"
    "jNPElpzVmbUq4JUagEiuTDkHzsxHpFKVK7q4+63SM1N95R1NbdWhscdCb+ZAJzVc\n"
    "oyi3B43njTOQ5yOf+1CceWxG1bQVs5ZufpsMljq4Ui0/1lvh+wjChP4kqKOJ2qxq\n"
    "4RgqsahDYVvTH9w7jXbyLeiNdd8XM2w9U/t7y0Ff/9yi0GE44Za4rF2LN9d11TPA\n"
    "mRGunUHBcnWEvgJBQl9nJEiU0Zsnvgc/ubhPgXRR4Xq37Z0j4r7g1SgEEzwxA57d\n"
    "emyPxgcYxn/eR44/KJ4EBs+lVDR3veyJm+kXQ99b21/+jh5Xos1AnX5iItreGCc=\n"
    "-----END CERTIFICATE-----\n";

// Security tag for credential storage.
#ifndef CONFIG_MQTT_TLS_SEC_TAG
#define CONFIG_MQTT_TLS_SEC_TAG 24
#endif
```

## src/diag_log.cpp
```c
#include "diag_log.hpp"

#include <zephyr/kernel.h>
#include <zephyr/logging/log.h>
#include <zephyr/settings/settings.h>
#include <string.h>

LOG_MODULE_REGISTER(diag_log, LOG_LEVEL_INF);

namespace alc
{

static DiagLog s_log;
static bool s_loaded = false;

static constexpr const char* SETTINGS_KEY = "diaglog/entries";

static int settingsSetHandler(const char* name, size_t len,
                               settings_read_cb read_cb, void* cb_arg)
{
    if (strcmp(name, "entries") == 0) {
        if (len != sizeof(DiagLog)) {
            LOG_WRN("Invalid diag log size: %zu (expected %zu)", len, sizeof(DiagLog));
            return -EINVAL;
        }

        int rc = read_cb(cb_arg, &s_log, sizeof(s_log));
        if (rc < 0) {
            LOG_ERR("Failed to read diag log: %d", rc);
            return rc;
        }

        if (s_log.magic == DiagLog::MAGIC) {
            s_loaded = true;
            LOG_INF("Loaded diag log: %d entries", s_log.count);
        } else {
            LOG_WRN("Invalid diag log magic: 0x%08X", s_log.magic);
            s_loaded = false;
        }

        return 0;
    }

    return -ENOENT;
}

SETTINGS_STATIC_HANDLER_DEFINE(diaglog, "diaglog", NULL, settingsSetHandler, NULL, NULL);

static int saveLog()
{
    int rc = settings_save_one(SETTINGS_KEY, &s_log, sizeof(s_log));
    if (rc < 0) {
        LOG_ERR("Failed to save diag log: %d", rc);
    }
    return rc;
}

int diagLogInit()
{
    // Settings are already loaded by retainedInit() -> settings_load().
    // Our handler was called during that load. Just check if we got valid data.
    if (!s_loaded) {
        LOG_INF("No valid diag log - initialising empty.");
        s_log.magic = DiagLog::MAGIC;
        s_log.count = 0;
        s_log.writeIndex = 0;
        memset(s_log.entries, 0, sizeof(s_log.entries));
        saveLog();
    }

    return 0;
}

void diagLogEvent(const DiagLogEntry& entry)
{
    s_log.entries[s_log.writeIndex] = entry;
    s_log.writeIndex++;

    if (s_log.writeIndex >= DIAG_LOG_MAX_ENTRIES) {
        s_log.writeIndex = 0;
    }

    if (s_log.count < DIAG_LOG_MAX_ENTRIES) {
        s_log.count++;
    }

    saveLog();
}

uint8_t diagLogCount()
{
    return s_log.count;
}

bool diagLogGet(uint8_t index, DiagLogEntry& entry)
{
    if (index >= s_log.count) {
        return false;
    }

    // Map logical index (0=oldest) to physical index.
    uint8_t physIndex;
    if (s_log.count < DIAG_LOG_MAX_ENTRIES) {
        // Buffer not full yet — entries start at 0.
        physIndex = index;
    } else {
        // Buffer full — oldest is at writeIndex.
        physIndex = (s_log.writeIndex + index) % DIAG_LOG_MAX_ENTRIES;
    }

    entry = s_log.entries[physIndex];
    return true;
}

void diagLogClear()
{
    LOG_INF("Clearing diag log (%d entries).", s_log.count);
    s_log.count = 0;
    s_log.writeIndex = 0;
    memset(s_log.entries, 0, sizeof(s_log.entries));
    saveLog();
}

} // namespace alc
```

## src/diag_log.hpp
```c
#pragma once

/**
 * @file diag_log.hpp
 * @brief Diagnostic wake log stored in NVS flash.
 *
 * Records every wake event with classification details in a 100-entry
 * circular buffer (~2.2 KB). Retrieved via MQTT dump_log command.
 */

#include <stdint.h>

namespace alc
{

enum class WakeClassification : uint8_t {
    Bump = 0,
    MailboxVisited = 1,
    DoorOpen = 2,
    TimerWake = 3,
    FreshBoot = 4,
    Provisioning = 5
};

struct DiagLogEntry {
    uint32_t timestamp;               // k_uptime_get() / 1000
    uint16_t awakePollMs;             // AWAKE poll duration (0 for bumps)
    int16_t settledX, settledY, settledZ;  // Settled position (mg)
    uint16_t batteryMv;               // Battery voltage
    uint8_t wakeSource;               // WakeSource enum
    WakeClassification classification;
    uint8_t doorOpenStage;            // Stage at time of event
    bool awakeAtBoot;                 // AWAKE pin state from main.cpp
    uint16_t activityThresholdMg;     // Active config
    uint8_t inactivityTime;           // Active config
};

static constexpr uint8_t DIAG_LOG_MAX_ENTRIES { 100 };

struct DiagLog {
    static constexpr uint32_t MAGIC = 0x444C4731;  // "DLG1"
    uint32_t magic;
    uint8_t count;        // Entries stored (0-100)
    uint8_t writeIndex;   // Next write position (circular)
    DiagLogEntry entries[DIAG_LOG_MAX_ENTRIES];
};

/**
 * @brief Initialise diagnostic log from NVS.
 * Must be called after settings_load() (i.e. after retainedInit()).
 */
int diagLogInit();

/**
 * @brief Add a diagnostic log entry and save to NVS.
 */
void diagLogEvent(const DiagLogEntry& entry);

/**
 * @brief Get number of stored entries.
 */
uint8_t diagLogCount();

/**
 * @brief Get entry by logical index (0 = oldest).
 */
bool diagLogGet(uint8_t index, DiagLogEntry& entry);

/**
 * @brief Clear all entries and save to NVS.
 */
void diagLogClear();

} // namespace alc
```

## src/fuel_gauge.cpp
```c
#include "fuel_gauge.hpp"
#include <zephyr/logging/log.h>

LOG_MODULE_REGISTER(fuel_gauge, LOG_LEVEL_INF);

namespace alc 
{

  FuelGauge::FuelGauge(const struct battery_model* batteryModel)
      : m_battery_model(batteryModel)
      , m_state{}
      , m_initialised(false)
  {
  }

  int FuelGauge::Init(float initialVoltage, float initialCurrent, float initialTemp, float maxChargeCurrent, float termChargeCurrent)
  {
    constexpr int OK { 0 };

    LOG_INF("Initializing fuel gauge, nRF Fuel Gauge version: %s", nrf_fuel_gauge_version);

    struct nrf_fuel_gauge_init_parameters parameters = {
      .model = m_battery_model,
      .opt_params = nullptr,
      .state = nullptr,
    };
    parameters.v0 = initialVoltage;
    // Note: nrf_fuel_gauge expects negative current for charging,
    // but we use positive for charging (Zephyr convention is opposite).
    parameters.i0 = -initialCurrent;
    parameters.t0 = initialTemp;

    int result { nrf_fuel_gauge_init(&parameters, nullptr) };
    if (result < 0) {
      LOG_ERR("Failed to initialise fuel gauge: %d!", result);
      return result;
    }

    // Set maximum charge current.
    union nrf_fuel_gauge_ext_state_info_data chargeLimitData;
    chargeLimitData.charge_current_limit = maxChargeCurrent;
    
    result = nrf_fuel_gauge_ext_state_update( NRF_FUEL_GAUGE_EXT_STATE_INFO_CHARGE_CURRENT_LIMIT, &chargeLimitData);
    if (result < 0) {
      LOG_ERR("Failed to set max charge current: %d!", result);
      return result;
    }

    // Set termination charge current.
    union nrf_fuel_gauge_ext_state_info_data termCurrentData;
    termCurrentData.charge_term_current = termChargeCurrent;
    
    result = nrf_fuel_gauge_ext_state_update(NRF_FUEL_GAUGE_EXT_STATE_INFO_TERM_CURRENT, &termCurrentData);
    if (result < 0) {
      LOG_ERR("Failed to set term charge current: %d!", result);
      return result;
    }

    // Initialise state.
    constexpr float socInitValue { 0.0f };
    constexpr float ttxInitValue { -1.0f };

    m_state.voltage = initialVoltage;
    m_state.current = initialCurrent;
    m_state.temperature = initialTemp;
    m_state.soc = socInitValue;
    m_state.tte = ttxInitValue;
    m_state.ttf = ttxInitValue;

    m_initialised = true;

    LOG_INF("Fuel gauge initialised: V=%.3fV, I=%.3fA, T=%.1f degC", (double)initialVoltage, (double)initialCurrent, (double)initialTemp);

    return OK;
  }

  int FuelGauge::Update(float voltage, float current, float temp, bool vbusConnected, float deltaSeconds)
  {
    constexpr int OK { 0 };

    if (!m_initialised) {
      LOG_ERR("Fuel gauge not initialised!");
      return -EINVAL;
    }

    // Update VBUS state if it changed.
    int result = updateVbusState(vbusConnected);
    if (result < 0) {
      LOG_ERR("Failed to update VBUS state: %d!", result);
      return result;
    }

    // Store current measurements.
    m_state.voltage = voltage;
    m_state.current = current;
    m_state.temperature = temp;

    // Process fuel gauge algorithm.
    // Note: nrf_fuel_gauge expects negative current for charging.
    m_state.soc = nrf_fuel_gauge_process(voltage, -current, temp, deltaSeconds, nullptr);
    m_state.tte = nrf_fuel_gauge_tte_get();
    m_state.ttf = nrf_fuel_gauge_ttf_get();

    LOG_DBG("Fuel gauge: V=%.3f, I=%.3f, T=%.1f, SoC=%.1f%%, TTE=%.0fs, TTF=%.0fs",
           (double)voltage, (double)current, (double)temp, 
           (double)m_state.soc, (double)m_state.tte, (double)m_state.ttf);

    return OK;
  }

  int FuelGauge::UpdateChargeState(enum nrf_fuel_gauge_charge_state chargeState)
  {
    constexpr int OK { 0 };

    if (!m_initialised) {
      LOG_ERR("Fuel gauge not initialized");
      return -EINVAL;
    }

    union nrf_fuel_gauge_ext_state_info_data stateInfo;
    stateInfo.charge_state = chargeState;

    int result { nrf_fuel_gauge_ext_state_update(NRF_FUEL_GAUGE_EXT_STATE_INFO_CHARGE_STATE_CHANGE, &stateInfo) };
    if (result < 0) {
      LOG_ERR("Failed to update charge state: %d!", result);
      return result;
    }

    const char* stateStr;
    switch (chargeState) 
    {
      case NRF_FUEL_GAUGE_CHARGE_STATE_IDLE:
        stateStr = "Idle";
        break;
      case NRF_FUEL_GAUGE_CHARGE_STATE_TRICKLE:
        stateStr = "Trickle";
        break;
      case NRF_FUEL_GAUGE_CHARGE_STATE_CC:
        stateStr = "Constant Current";
        break;
      case NRF_FUEL_GAUGE_CHARGE_STATE_CV:
        stateStr = "Constant Voltage";
        break;
      case NRF_FUEL_GAUGE_CHARGE_STATE_COMPLETE:
        stateStr = "Complete";
        break;
      default:
        stateStr = "Unknown";
        break;
    }

    LOG_DBG("Charge state: %s", stateStr);

    return OK;
  }

  int FuelGauge::updateVbusState(bool connected)
  {
    constexpr int OK { 0 };

    enum nrf_fuel_gauge_ext_state_info_type state = connected 
      ? NRF_FUEL_GAUGE_EXT_STATE_INFO_VBUS_CONNECTED
      : NRF_FUEL_GAUGE_EXT_STATE_INFO_VBUS_DISCONNECTED;

    int result = nrf_fuel_gauge_ext_state_update(state, nullptr);
    if (result < 0) {
      LOG_ERR("Failed to update VBUS state: %d", result);
      return result;
    }

    return OK;
  }
} 
```

## src/fuel_gauge.hpp
```c
#pragma once

#include <nrf_fuel_gauge.h>

namespace alc 
{

  /**
   * @brief Battery Fuel Gauge using Nordic nrf_fuel_gauge library.
   * 
   * Provides battery state-of-charge (SoC), time-to-empty (TTE), and 
   * time-to-full (TTF) estimations based on voltage, current, and temperature
   * measurements.
   * 
   * The fuel gauge is sensor-agnostic and can work with any source of
   * battery voltage, current, and temperature data.
   */
  
  class FuelGauge 
  {
    public:
      /**
       * @brief Fuel gauge state structure.
       */
      struct State {
          float soc;          // State of charge (0.0 to 100.0).
          float tte;          // Time to empty in seconds (-1 if not applicable).
          float ttf;          // Time to full in seconds (-1 if not applicable).
          float voltage;      // Last voltage reading.
          float current;      // Last current reading.
          float temperature;  // Last temperature reading.
      };

      /**
       * @brief Constructor.
       * @param battery_model Pointer to battery model parameters (must remain valid).
       */
      explicit FuelGauge(const struct battery_model* battery_model);

      /**
       * @brief Initialise the fuel gauge.
       * @param initialVoltage Initial battery voltage in volts.
       * @param initialCurrent Initial battery current in amps (positive = charging).
       * @param initialTemp Initial battery temperature in celsius.
       * @param maxChargeCurrent Maximum charging current in amps.
       * @param termChargeCurrent Termination charging current in amps.
       * @return 0 on success, negative error code on failure.
       */
      int Init(float initialVoltage, float initialCurrent, float initialTemp, float maxChargeCurrent, float termChargeCurrent);

      /**
       * @brief Update fuel gauge with new measurements.
       * @param voltage Battery voltage in volts.
       * @param current Battery current in amps (positive = charging, negative = discharging).
       * @param temp Battery temperature in celsius.
       * @param vbusConnected True if VBUS/charger is connected.
       * @param deltaSeconds Time since last update in seconds.
       * @return 0 on success, negative error code on failure.
       */
      int Update(float voltage, float current, float temp, bool vbusConnected, float deltaSeconds);

      /**
       * @brief Inform fuel gauge of charge state change.
       * @param chargeState New charge state.
       * @return 0 on success, negative error code on failure.
       */
      int UpdateChargeState(enum nrf_fuel_gauge_charge_state chargeState);

      /**
       * @brief Get current fuel gauge state.
       * @return Current state.
       */
      const State& GetState() const { return m_state; }

      /**
       * @brief Get state of charge.
       * @return SoC percentage (0.0 to 100.0)
       */
      float GetSoc() const { return m_state.soc; }

      /**
       * @brief Get time to empty.
       * @return Time to empty in seconds, -1 if not applicable.
       */
      float GetTte() const { return m_state.tte; }

      /**
       * @brief Get time to full.
       * @return Time to full in seconds, -1 if not applicable.
       */
      float GetTtf() const { return m_state.ttf; }

      /**
       * @brief Check if fuel gauge is initialised.
       * @return True if initialised.
       */
      bool IsInitialised() const { return m_initialised; }

    private:
      const struct battery_model* m_battery_model;
      State m_state;
      bool m_initialised;

      /**
       * @brief Update VBUS connection state in fuel gauge.
       */
      int updateVbusState(bool connected);
  };
}
```

## src/led.cpp
```c
#include <zephyr/logging/log.h>
#include "led.hpp"

LOG_MODULE_REGISTER(led, LOG_LEVEL_INF);
namespace alc 
{
  Led* Led::s_instance = nullptr;

  Led::Led():
    m_led_red(PWM_DT_SPEC_GET(DT_ALIAS(led0_red))),
    m_led_green(PWM_DT_SPEC_GET(DT_ALIAS(led0_green))),
    m_led_blue(PWM_DT_SPEC_GET(DT_ALIAS(led0_blue))),
    m_flash_colour(LedColours::OFF),
    m_flash_state(false)
  {
    s_instance = this;
    k_timer_init(&m_flash_timer, flashTimerHandler, nullptr);
  }

  bool Led::Init()
  {
    if (!pwm_is_ready_dt(&m_led_red) || !pwm_is_ready_dt(&m_led_green) || !pwm_is_ready_dt(&m_led_blue)) {
      LOG_ERR("LED PWM not ready!");
      return false;
    }
      
    SetColour(LedColours::OFF);
    LOG_INF("LED initialised.");
    return true;
  }

  void Led::SetColour(const RgbColour& colour)
  {
    uint32_t period { m_led_red.period };
    
    pwm_set_dt(&m_led_red, period, (period * colour.red / 100));
    pwm_set_dt(&m_led_green, period, (period * colour.green / 100));
    pwm_set_dt(&m_led_blue, period, (period * colour.blue / 100));
  }

  void Led::StartFlashing(const RgbColour& colour, uint32_t periodMs)
  {
    k_timer_stop(&m_flash_timer);
    m_flash_colour = colour;
    m_flash_state = false;
    k_timer_start(&m_flash_timer, K_MSEC(periodMs), K_MSEC(periodMs));
  }

  void Led::StopFlashing() 
  {
    k_timer_stop(&m_flash_timer);
    SetColour(LedColours::OFF);
  }

  void Led::toggleFlash() 
  {
    m_flash_state = !m_flash_state;
    SetColour(m_flash_state ? m_flash_colour : LedColours::OFF);
  }

  void Led::flashTimerHandler(k_timer* timer) 
  {
    s_instance->toggleFlash();
  }
}
```

## src/led.hpp
```c
#pragma once

#include <zephyr/kernel.h>
#include <zephyr/drivers/pwm.h>

namespace alc
{
  struct RgbColour {
    uint8_t red;
    uint8_t green;
    uint8_t blue;
  };

  // Common colors
  namespace LedColours {
    constexpr RgbColour OFF = { 0, 0, 0 };
    constexpr RgbColour AMBER = { 100, 50, 0 };
    constexpr RgbColour ORANGE = { 100, 30, 0 };
    constexpr RgbColour RED = { 100, 0, 0 };
    constexpr RgbColour GREEN = { 0, 100, 0 };
    constexpr RgbColour BLUE = { 0, 0, 100 };
  }

  class Led 
  {
    public:
      Led();
      
      bool Init();
      void SetColour(const RgbColour& colour);
      void StartFlashing(const RgbColour& colour, uint32_t periodMs);
      void StopFlashing();
      
    private:
      static void flashTimerHandler(struct k_timer *timer);
      void toggleFlash();
      
      pwm_dt_spec m_led_red;
      pwm_dt_spec m_led_green;
      pwm_dt_spec m_led_blue;
      
      k_timer m_flash_timer;
      RgbColour m_flash_colour;
      bool m_flash_state;
      
      static Led* s_instance;
  };
}
```
